/*
 * SAMSUNG EXYNOS device tree source for reserved-memory
 *
 * Copyright (c) 2017 Samsung Electronics Co., Ltd.
 *		http://www.samsung.com
 *
 * This program is free software; you can redistribute it and/or modify
 * it under the terms of the GNU General Public License version 2 as
 * published by the Free Software Foundation.
 */

&reserved_memory {
	camera {
		compatible = "exynos8890-ion,camera";
		ion,recyclable;
		reg = <0x8 0x80000000 0x1B800000>;
		alignment = <0x0 0x00400000>;
		id = <10>;
	};
	secure_camera {
		compatible = "exynos8890-ion,secure_camera";
		ion,secure;
		reg = <0x0 0xE1900000 0x2000000>;
		alignment = <0x0 0x00400000>;
		id = <11>;
	};
	camera_contig {
		compatible = "exynos8890-ion,camera_contig";
		ion,secure;
		reg = <0x0 0x95000000 0x700000>;
		alignment = <0x0 0x00400000>;
		id = <12>;
	};
};